## wifi_driver/meta-virtualwifi/conf/layer.conf
```bitbake
# We have a conf and classes directory, add to BBPATH
BBPATH .= ":${LAYERDIR}"

# We have recipes-* directories, add to BBFILES
BBFILES += "${LAYERDIR}/recipes-*/*/*.bb \
            ${LAYERDIR}/recipes-*/*/*.bbappend"

BBFILE_COLLECTIONS += "meta-virtualwifi"
BBFILE_PATTERN_meta-virtualwifi = "^${LAYERDIR}/"
BBFILE_PRIORITY_meta-virtualwifi = "6"

LAYERDEPENDS_meta-virtualwifi = "core"
LAYERSERIES_COMPAT_meta-virtualwifi = "dunfell"
```
